## ble-indoor-positioning/firmware/esp32_wifi_anchor/sdkconfig.defaults
```kconfig
# Bluetooth NimBLE Configuration
CONFIG_BT_ENABLED=y
CONFIG_BTDM_CTRL_MODE_BLE_ONLY=y
CONFIG_BTDM_CTRL_MODE_BR_EDR_ONLY=n
CONFIG_BTDM_CTRL_MODE_BTDM=n
CONFIG_BT_BLUEDROID_ENABLED=n
CONFIG_BT_NIMBLE_ENABLED=y

# Memory & Partitions
CONFIG_PARTITION_TABLE_SINGLE_APP_LARGE=y

# Wi-Fi & Network Configuration
CONFIG_ESP_WIFI_IRAM_OPT=n
CONFIG_LWIP_MAX_SOCKETS=10
CONFIG_LWIP_SO_REUSE=y
CONFIG_LWIP_SO_RCVBUF=y
CONFIG_LWIP_NETBUF_RECVINFO=y
```
